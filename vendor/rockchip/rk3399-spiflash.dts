/dts-v1/;
/plugin/;

/ {
	compatible = "rockchip,rk3399";

	fragment@0 {
		target = <&spi0>;
		__overlay__ {
			status = "okay";
			spiflash@0 {
				compatible = "jedec,spi-nor";
				reg = <0>;
				spi-max-frequency = <50000000>;
			};
		};
	};
};
